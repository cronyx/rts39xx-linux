## Documentation/devicetree/bindings/bus/realtek,rts-xb2.txt
```
Realtek XB2 Controller

Required properties:
- compatible: "realtek,rts3903-xb2"
- reg: Address range of the XB2 registers
- interrupt: Should contain the XB2 interrupt number
- interrupt-parent: Should be the phandle for the interrupt controller
  that services interrupts for this device

Example:

	xb2: xb2@0x18870000 {
		compatible = "realtek,rts3903-xb2";
		reg = <0x18870000 0x30>;
		interrupts = <BSP_IRQ_OTHERS>;
		interrupt-parent = <&cpuintc>;
	};
```

## Documentation/devicetree/bindings/clock/realtek,rts-clocks.txt
```
Realtek Clock Controller

Required properties:
- compatible: Should be "realtek,rts3903-clocks" or "realtek,rts3913-clocks"
- reg: Address range of the clock registers
- #clock-cells: Should be 1

Example:

	clks: clks@18861000  {
		compatible = "realtek,rts3903-clocks";
		#clock-cells = <1>;
		reg = <0x18861000 0x1000 0x18864100 0x400>;
	};
```

## Documentation/devicetree/bindings/cpufreq/realtek,rts-cpufreq.txt
```
Realtek CPU frequency scaling driver bindings
----------------------------------------------

Both required and optional properties listed below must be defined
under node /cpus/cpu@0.

Required properties:
- clocks: Must contain an entry for each entry in clock-names.
  See ../clocks/clock-bindings.txt for details.
- clock-names: Must include the following entries:
  - cpu_ck: Clock for the CPU.
- operating-pointer: Table of frequencies and voltage CPU could be transitioned into,
	in the decreasing order. Frequency should be in KHz units.

Example:
--------
cpus {
	#address-cells = <1>;
	#size-cells = <0>;

	cpu@0 {
		device_type = "cpu";
		compatible = "realtek,rlx5281";
		reg = <0>;
		clocks = <&clks RLX_CLK_CPU_CK>;
		clock-names = "cpu_ck";
		operating-points = <
				/* kHz  uV */
				500000  0
				400000  0
				300000  0
				200000  0
				>;
	};

	<...>
};
```

## Documentation/devicetree/bindings/crypto/realtek,rts-crypto.txt
```
Realtek crypto accelerator present in RTS39xx IPCam processors.

The crypto accelerator provides hardware acceleration for
AES/DES/3DES algorithms.

Required properties:

- compatible: "realtek,rts3903-crypto"
- reg: Offset and length of the register set for the block
- interrupts: The designated IRQ line for the block
- clocks: Clock specifiers
- clock-names: identifier string for clock specifiers
- resets: list of two reset specifiers
- reset-names: identifier string for reset specifiers
- aes/des/3des: list of supported algorithms

Example:

	crypto: crypto@18600000 {
		compatible = "realtek,rts3903-crypto";
		reg = <0x18600000 0x10000>;
		interrupt-parent = <&vecintc>;
		interrupts = <BSP_IRQ_ENCPY>;
		clocks = <&clks RLX_CLK_CIPHER_CK>;
		clock-names = "cipher_ck";
		resets = <&reset FORCE_RESET_CIPHER>,
			<&sysmem SYS_MEM_SD_CIPHER>;
		reset-names = "rst", "sd";
		aes = "ecb", "cbc", "cbccs1", "cbccs2", "cbccs3", "ctr";
		des = "ecb", "cbc", "cbccs1", "cbccs2", "cbccs3", "ctr";
		3des = "ecb", "cbc", "cbccs1", "cbccs2", "cbccs3", "ctr";
	};
```

## Documentation/devicetree/bindings/dma/realtek,rts-dma.txt
```
* Realtek DMA Controller

Required properties:
- compatible: "realtek,rts3903-dmac"
- reg: Address range of the DMAC registers
- interrupt: Should contain the DMAC interrupt number
- clocks: Clock for dma controller
- dma-channels: Number of channels supported by hardware
- dma-vchannels: Number of virtual channels
- dma-masters: Number of AHB masters supported by the controller
- chan_priority: priority of channels. 0 (default): increase from chan 0->n, 1:
  increase from chan n->0
- block_size: Maximum block size supported by the controller
- data-width: Maximum data width supported by hardware per AHB master
  (in bytes, power of 2)

Optional properties:
- interrupt-parent: Should be the phandle for the interrupt controller
  that services interrupts for this device
- is_private: The device channels should be marked as private and not for by the
  general purpose DMA channel allocator. False if not passed.

Example:

	dmahost: dma@18020000 {
		compatible = "realtek,rts3903-dmac";
		reg = <0x18020000 0x100>;
		interrupt-parent = <&cpuintc>;
		interrupts = <BSP_IRQ_DMA>;

		dma-channels = <4>;
		dma-requests = <4>;
		dma-masters = <1>;
		chan_priority = <1>;
		block_size = <0xfff>;
		data-width = <2 2 0 0>;
	};
```

## Documentation/devicetree/bindings/hwmon/realtek,rts-saradc.txt
```
Realtek SARADC Controller

Required properties:
- compatible: "realtek,rts3903-saradc"
- reg: Address range of the saradc registers

Example:

	saradc: saradc@0x18840000 {
		compatible = "realtek,rts3903-saradc";
		reg = <0x18840000 0x10000>;
		status = "disabled";
	};
```

## Documentation/devicetree/bindings/i2c/realtek,rts-i2c.txt
```
Realtek I2C Controller

Required properties:
- compatible: "realtek,rts3903-i2c"
- reg: Address range of the i2c registers
- interrupt: Should contain the i2c interrupt number
- interrupt-parent: Should be the phandle for the interrupt controller
  that services interrupts for this device
- clocks: Clock for i2c controller
- clock-names: Name of clock
- resets: List of phandle and reset specifier pairs, one pair for
  each reset signal that affects the device.
- reset-names: List of reset signal name strings sorted in the same order as
  the resets property.

Example:

	i2c: i2c@0x18880000 {
		compatible = "realtek,rts3903-i2c";
		reg = <0x18880000 0x1000>;
		interrupts = <BSP_IRQ_OTHERS>;
		interrupt-parent = <&cpuintc>;
		clocks = <&clks RLX_CLK_I2C_CK>;
		clock-names = "i2c_ck";
		resets = <&reset FORCE_RESET_I2C>;
		reset-names = "reset-i2c";
		#address-cells = <1>;
		#size-cells = <0>;
		status = "disabled";
	};
```

## Documentation/devicetree/bindings/interrupt-controller/realtek,intc.txt
```
Realtek CPU Interrupt Controller

Required properties:
- compatible: "mti,cpu-interrupt-controller"
- interrupt-controller : Identifies the node as an interrupt controller.
- #interrupt-cells : Specifies the number of cells needed to encode an
  interrupt source.

Example:

	cpuintc: cpuintc@0 {
		#address-cells = <0>;
		#interrupt-cells = <1>;
		interrupt-controller;
		compatible = "mti,cpu-interrupt-controller";
	};

Realtek VEC Interrupt Controller

Required properties:
- compatible: "realtek,vec-interrupt-controller"
- interrupt-controller : Identifies the node as an interrupt controller.
- #interrupt-cells : Specifies the number of cells needed to encode an
  interrupt source.

Example:

	vecintc: vecintc@0 {
		#address-cells = <0>;
		#interrupt-cells = <1>;
		interrupt-controller;
		compatible = "realtek,vec-interrupt-controller";
	};
```

## Documentation/devicetree/bindings/media/realtek,rts-h264.txt
```
* Realtek H264 controller

Required properties:
- compatible: Should be "realtek,rts3903-h264"
- reg: Address and length of the register set for the device
- interrupt-parent: Phandle of the parent interrupt controller
- interrupts: Should contain the h264 interrupt number
- clocks: Clock for h264 controller
- clock-names: Name of clock
- clock-frequency : Clock frequency for h264 controller
- resets: List of phandle and reset specifier pairs, one pair for
each reset signal that affects the device
- reset-names: List of reset signal name strings sorted in the same order as
the resets property

Example:
	rts_h264_hx280enc@18060000 {
		compatible = "realtek,rts3903-h264";
		reg = <0x18060000 0x00020000>;
		interrupt-parent = <&vecintc>;
		interrupts = <BSP_IRQ_H264>;
		clocks = <&clks RLX_CLK_H264_CK>;
		clock-names = "h264_clk";
		clock-frequency = <333333333>;
		resets = <&reset FORCE_RESET_H264>;
		reset-names = "h264_rst";
		status = "disabled";
	};
```

## Documentation/devicetree/bindings/media/realtek,rts-h265.txt
```
* Realtek H265 controller

Required properties:
- compatible: Should be "realtek,rts3913-vpucodec"
- reg: Address and length of the register set for the device
- interrupt-parent: Phandle of the parent interrupt controller
- interrupts: Should contain the h265 interrupt number
- clocks: List of clock for H265 controller
- clock-names: List of clock name strings sorted in the same order as
the clocks property
- clock-frequency : List of clock frequency sorted in the same order as
the clocks property
- resets: List of phandle and reset specifier pairs, one pair for
each reset signal that affects the device
- reset-names: List of reset signal name strings sorted in the same order as
the resets property


Example:
	rts_h265_vpucodec@0x180c0000 {
		compatible = "realtek,rts3913-vpucodec";
		reg = <0x180c0000 0x00040000>;
		interrupt-parent = <&vecintc>;
		interrupts = <BSP_IRQ_H265>;
		clocks = <&clks RLX_CLK_H265_CK>, \
				<&clks RLX_CLK_H265_ACLK_CK>, \
				<&clks RLX_CLK_H265_BCLK_CK>, \
				<&clks RLX_CLK_H265_CCLK_CK>;
		clock-names = "h265_ck", "h265_aclk_ck", \
				"h265_bclk_ck", "h265_cclk_ck";
		clock-frequency = <0 0 120000000 120000000>;
		resets = <&reset FORCE_RESET_H265_AXI>, \
				<&reset FORCE_RESET_H265_BPU>, \
				<&reset FORCE_RESET_H265_CORE>, \
				<&sysmem SYS_MEM_SD_H265>;
		reset-names = "axi", "bpu", "core", "sysmem-up";
	};
```

## Documentation/devicetree/bindings/media/realtek,rts-isp.txt
```
* Realtek isp controller

this module consists of two parts: one is rts_mcu, the other is rts_soc_camera.

1) rts_mcu

Required properties:
- compatible: Should be "realtek,rts3903-mcu"
- reg: Address and length of the register set for the device
- interrupt-parent: Phandle of the parent interrupt controller
- interrupts: Should contain the isp interrupt number
- clocks: Clock for mcu clk and hclk
- clock-names: Name of clock
- resets: List of phandle and reset specifier pairs, one pair for
each reset signal that affects the device
- reset-names: List of reset signal name strings sorted in the same order as
the resets property
- subdev: Yes or no
- fw-size: Length of MCU firmware
- io-supply: Io power supply
- analog-supply: Analog power supply
- core-supply: Core power supply
- status: Either "ok" or "disabled"
- isp-cmd: Configuration of isp cmd

Example:
	rts_mcu: rts_mcu@18040000 {
		compatible = "realtek,rts3903-mcu";
		reg = <0x18040000 0x00010000>;
		interrupt-parent = <&vecintc>;
		interrupts = <BSP_IRQ_MCU8051>;
		clocks = <&clks RLX_CLK_MCU_CK>, \
				<&clks RLX_CLK_SYS_PLL3>;
		clock-names = "mcu_clk", "hclk";
		resets = <&reset FORCE_RESET_MCU_PREPARE>, \
				<&reset FORCE_RESET_MCU_DONE>, \
				<&reset FORCE_RESET_VIDEO>, \
				<&reset FORCE_RESET_ISP>, \
				<&reset FORCE_RESET_MIPI>;
		reset-names = "mcu_prepare", \
				"mcu_done", \
				"video", \
				"isp", \
				"mipi";
		subdev;
		fw-size = <262144>;
		io-supply = <&ldo3_reg>;
		analog-supply = <&ldo5_reg>;
		core-supply = <&dcdc2_reg>;
		status = "disabled";

		isp-cmd {
			#address-cells = <1>;
			#size-cells = <1>;
			read {
				reg = <0x00001100 48>;
			};
			write {
				reg = <0x00001000 16>;
			};
		};
	}

2) rts_soc_camera

Required properties:
- compatible: Should be "realtek,rts3903-isp"
- reg: Address and length of the register set for the device
- interrupt-parent: Phandle of the parent interrupt controller
- interrupts: Should contain the isp interrupt number
- devtype: Hardware version
- hw-id: Hardware id
- is-fpga: Yes or no
- isp-buffer-config: Configuration of isp buffer
- td-config: Configuration of TD
- status: Either "ok" or "disabled"

Example:
	rts_soc_camera: rts_soc_camera@18040000 {
		compatible = "realtek,rts3903-isp";
		reg = <0x18040000 0x00010000>;
		interrupt-parent = <&vecintc>;
		interrupts = <BSP_IRQ_MCU8051>;
		devtype = "rts3913";
		hw-id = <4>;
		is-fpga;
		isp-buffer-config = <&icfg0>, <&icfg1>, \
					<&icfg2>, <&icfg3>;
		td-config = <&tdcfg>;
		status = "disabled";
	};
```

## Documentation/devicetree/bindings/media/realtek,rts-mem.txt
```
* Realtek Video Memory controller

Required properties:
- compatible: Should be "realtek,rts3903-ispmem"
- memory-region: The video reserved memory
- use-adma: Use adma or not

Example:
	rtsmem: rts_isp_mem {
		compatible = "realtek,rts3903-ispmem";
		memory-region = <&video_reserved>;
		use-adma;
	};
```

## Documentation/devicetree/bindings/media/realtek,rts-mjpeg.txt
```
* Realtek Mjpeg controller

Required properties:
- compatible: Should be "realtek,rts3903-jpgenc"
- reg: Address and length of the register set for the device
- interrupt-parent: Phandle of the parent interrupt controller
- interrupts: Should contain the mjpeg interrupt number
- clocks: Clock for mjpeg controller
- clock-names: Name of clock
- clock-frequency : Clock frequency for mjpeg controller
- resets: List of phandle and reset specifier pairs, one pair for
each reset signal that affects the device
- reset-names: List of reset signal name strings sorted in the same order as
the resets property
- jpg-config: Configuration of mjpeg
- status: Either "ok" or "disabled"

Example:
	rts_mjpeg_enc: rts_jpgenc@1805e000 {
		compatible = "realtek,rts3903-jpgenc";
		reg = <0x1805e000 0x00002000>;
		interrupt-parent = <&vecintc>;
		interrupts = <BSP_IRQ_MCU8051>;
		clocks = <&clks RLX_CLK_JPEG_CK>;
		clock-names = "jpeg_clk";
		clock-frequency = <100000000>;
		resets = <&reset FORCE_RESET_JPG>;
		reset-names = "jpeg_rst";
		jpg-config = <&jpgcfg>;
		status = "disabled";
	};
```

## Documentation/devicetree/bindings/media/realtek,rts-osd.txt
```
* Realtek Osd controller

Required properties:
- compatible: Should be "realtek,rts3903-osd2"
- reg: Address and length of the register set for the device
- interrupt-parent: Phandle of the parent interrupt controller
- interrupts: Should contain the osd interrupt number
- osd-config: Configuration of osd
- status: Either "ok" or "disabled"

Example:
	rts_osd_enc: rts_osd2@1805c000 {
		compatible = "realtek,rts3903-osd2";
		reg = <0x1805c000 0x00001ffd>;
		interrupt-parent = <&vecintc>;
		interrupts = <BSP_IRQ_MCU8051>;
		osd-config = <&osd2cfg>;
		status = "disabled";
	};
```

## Documentation/devicetree/bindings/misc/realtek,rts-ddrc.txt
```
Realtek DDR Controller

Required properties:
- compatible: "realtek,rts3903-ddrc"
- reg: Address range of the DDR Controller registers

Example:

	ddrc: ddrc@0x18010000 {
		compatible = "realtek,rts3903-ddrc";
		reg = <0x18010000 0x100 0x18080000 0x100>;
		status = "disabled";
	};
```

## Documentation/devicetree/bindings/mmc/realtek,rts-mmc.txt
```
* Realtek rts39xx SoC SDIO host controller

Required properties/subnode:
- compatible: Should be "realtek,rts3903-sdhc" or "realtek,rts3913-sdhc2"
- reg: Address and length of the register set for the device
- interrupt-parent: Phandle of the parent interrupt controller
- interrupts: Should contain sdio controller interrupt
- resets: List of phandle and reset specifier pairs, one pair for
each reset signal that affects the device.
- reset-names: List of reset signal name strings sorted in the same order as
the resets property.
- disable-wp: make card always writable.
- cd-inverted: when present, polarity on the CD line is inverted.
- bus-width: Number of data lines, can be <1>, <4>, or <8>.  The default
  will be <1> if the property is absent.
- cap-sd-highspeed: SD high-speed timing is supported
- cap-mmc-highspeed: MMC high-speed timing is supported
- sd-uhs-sdr12: SD UHS SDR12 speed is supported
- sd-uhs-sdr25: SD UHS SDR25 speed is supported
- sd-uhs-sdr50: SD UHS SDR50 speed is supported

Example:
	sdhc: sdhc@18300000 {
		compatible = "realtek,rts3903-sdhc";
		reg = <0x18300000 0x100000>;
		interrupt-parent = <&vecintc>;
		interrupts = <BSP_IRQ_SD>;
		resets = <&reset FORCE_RESET_SD>,    \
			<&sysmem SYS_MEM_SD_SDIO>;
		reset-names = "reset-sd-device", "sdio-sysmem-up";
		disable-wp;
		cd-inverted;
		bus-width = <8>;
		cap-sd-highspeed;
		cap-mmc-highspeed;
		sd-uhs-sdr12;
		sd-uhs-sdr25;
		sd-uhs-sdr50;
	};
```
