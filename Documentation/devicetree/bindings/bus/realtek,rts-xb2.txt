## Documentation/devicetree/bindings/mtd/realtek,rts-nand.txt
```
* Realtek rts39xx spi nand flash controller

Required properties/subnode:
- compatible: Should be "realtek,rts3903-quadspi-nfc"
- reg: Address and length of the register set for the device
- interrupt-parent: Phandle of the parent interrupt controller
- interrupts: Should contain sdio controller interrupt
- clocks : Clock specifiers
- clock-names : identifier string for clock specifiers
- resets : list of two reset specifiers
- reset-names:  identifier string for reset specifiers

Example:
	spi0: spic@0x18030000 {
		compatible = "realtek,rts3903-quadspi-nfc";
		#address-cells = <1>;
		#size-cells = <0>;
		reg = <0x18030000 0x10000>;
		clocks = <&clks RLX_CLK_BUS_CK>;
		clock-names = "spi_ck";
		spi-max-frequency = <60000000>;
		interrupt-parent = <&cpuintc>;
		interrupts = <BSP_IRQ_SPI>;
		resets = <&sysmem SYS_MEM_SD_NAND_SPIC>;
		reset-names = "spi-nand-sysmem-up";
	};
```

## Documentation/devicetree/bindings/mtd/realtek,rts-nor.txt
```
* Realtek rts39xx spi nor flash controller

Required properties/subnode:
- compatible: Should be "realtek,rts3903-quadspi"
- reg: Address and length of the register set for the device
- interrupt-parent: Phandle of the parent interrupt controller
- interrupts: Should contain sdio controller interrupt
- clocks : Clock specifiers
- clock-names : identifier string for clock specifiers

Example:
	spi0: spic@0x18030000 {
		compatible = "realtek,rts3903-quadspi";
		#address-cells = <1>;
		#size-cells = <0>;
		reg = <0x18030000 0x10000>;
		clocks = <&clks RLX_CLK_BUS_CK>;
		clock-names = "spi_ck";
		spi-max-frequency = <60000000>;
		interrupt-parent = <&cpuintc>;
		interrupts = <BSP_IRQ_SPI>;
	};
```

## Documentation/devicetree/bindings/net/realtek,rts-r8168.txt
```
* Realtek rts39xx SoC Ethernet controller

Required properties/subnode:
- compatible: Should be "realtek,rts3903-r8168"
- reg: Address and length of the register set for the device
- interrupt-parent: Phandle of the parent interrupt controller
- interrupts: Should contain ethernet controller interrupt
- resets: List of phandle and reset specifier pairs, one pair for
each reset signal that affects the device.
- reset-names: List of reset signal name strings sorted in the same order as
the resets property.
- led_configs node: Ethernet status led configuration. Additional information is
below.

led_configs subnode indicates how the ethernet status leds work.
Required properties:
- led-pin: 1 means the led works, -1 means the led doesn't work.
- link-mode: led blinks whether ethernet works on 10M, 100M or 1000M mode.
- act-full: 1 means led works on all speed link, 0 means led works only on selected speed link.
- act-high-active: 1 means led high active, 0 means led low active.

Example:
	eth0: ethernet@31060000 {
			compatible = "realtek,rts3903-r8168";
			reg = <0x18400000 0x10000>;
			interrupt-parent = <&vecintc>;
			interrupts = <2>;

			resets = <&reset 17>, <&reset 18>;
			reset-names = "reset-eth", "reset-eth-clr";

			led_configs {
				led_config@0 {
					led-pin = <1>;
					link-mode = <100>;
					act-full = <1>;
					act-high-active = <0>;
				};
				led_config@1 {
					led-pin = <1>;
					link-mode = <100>;
					act-full = <1>;
					act-high-active = <0>;
				};
				led_config@2 {
					led-pin = <1>;
					link-mode = <100>;
					act-full = <1>;
					act-high-active = <0>;
				};
			};
	};
```

## Documentation/devicetree/bindings/nvmem/realtek,rts-efuse.txt
```
= Realtek RTS-EFUSE device tree bindings =

This binding is intended to represent RTS-EFUSE which is found in Realtek SOCs.

Required properties:
- compatible: should be "realtek,rts3903-efuse"
- reg: Should contain registers location and length

= Data cells =
Are child nodes of RTS-EFUSE, bindings of which as described in
bindings/nvmem/nvmem.txt

Example:

	efuse: efuse@18865000 {
		compatible = "realtek,rts3903-efuse";
		reg = <0x18865000 0x1000>;
		#address-cells = <1>;
		#size-cells = <1>;
	};

= Data consumers =
Are device nodes which consume nvmem data cells.
```

## Documentation/devicetree/bindings/phy/realtek,rts-usbphy.txt
```
Realtek rts39xx SoC USB PHY
=====================

Required properties:
--------------------
 - compatible: Must be "realtek,rts3903-usbphy".
 - reg : USB phy register range (address and length)

Example:
--------
usb_phy: usbphy@18140000 {
		compatible = "realtek,rts3903-usbphy";
		reg = <0x18140000 0x1000 0x18240000 0x1000>;
};
```

## Documentation/devicetree/bindings/pinctrl/realtek,rts-pinctrl.txt
```
Realtek Pin Function Controller

Required properties:
- compatible: "realtek,rts3903-pinctrl"
- reg: Address range of the pinctrl registers
- interrupt: Should contain the pinctrl interrupt number
- interrupt-parent: Should be the phandle for the interrupt controller
  that services interrupts for this device

Please refer to pinctrl-bindings.txt in this directory for details of the
common pinctrl bindings used by client devices, including the meaning of the
phrase "pin configuration node".

Optional properties for pin configuration sub-nodes:
  - bias-pull-up: Enable weak pull-up.
  - bias-pull-down: Enable weak pull-down.
  - bias-disable: Enable no pull.

Example:

	pinctrl: pinctrl@0x18800000UL {
		#address-cells = <1>;
		#size-cells = <1>;
		ranges;
		compatible = "realtek,rts3903-pinctrl";
		reg = <0x18800000 0x10000>;
		interrupts = <BSP_IRQ_OTHERS>;
		interrupt-parent = <&cpuintc>;
		status = "disabled";

		serial8250_default_mode: serial8250_default {
			default_mux {
				function = "uartfunc";
				groups = "uart1grp";
			};
		};

		audio_default_mode: audio_default {
			default_mux {
				function = "dmicfunc";
				groups = "dmicgrp";
			};
		};

		usbd_default_mode: usbd_default {
			default_mux {
				function = "usbdfunc";
				groups = "usbdgrp";
			};
		};

		eth_default_mode: eth_default {
			default_mux {
				function = "etnledfunc";
				groups = "etnled1grp";
			};
		};

		pwm_default_mode: pwm_default {
			default_mux {
				function = "pwmfunc";
				groups = "pwm0grp","pwm1grp",
					"pwm2grp","pwm3grp";
			};
		};

		isp_default_mode: isp_default {
				default_mux {
					function = "mcufunc";
					groups = "mcugrp";
				};
				default_cfg {
					pins = "GPIO50", "GPIO51";
					bias-disable;
				};
		};
	};
```

## Documentation/devicetree/bindings/pwm/realtek,rts-pwm.txt
```
Realtek PWM Controller

Required properties:
- compatible: "realtek,rts3903-pwm"
- reg: Address range of the PWM registers
- pinctrl-names: Set to "default"
- pinctrl-0: List of phandles pointing to pin configuration nodes
  for PWM module.

Example:

	pwm: pwm@0x18820000 {
		compatible = "realtek,rts3903-pwm";
		reg = <0x18820000 0x10000>;
		pinctrl-names = "default";
		pinctrl-0 = <&pwm_default_mode>;
		status = "disabled";
	};
```

## Documentation/devicetree/bindings/regulator/realtek,rtp590x.txt
```
Binding for Realtek rtp590x Driver

Required properties:
- compatible: "realtek,rtp5901" or "realtek,rtp5903"
- reg: I2C slave address

Optional properties:
- regulator-microvolt: default voltage

  Sub nodes for regulator_init_data
    rtp5901 has maximum 9 nodes. (label name: ldo1_reg ~ ldo5_reg and dcdc1_reg ~ dcdc4_reg)
    rtp5903 has maximum 6 nodes. (label name: ldo3_reg, ldo5_reg and dcdc1_reg ~ dcdc4_reg)
    For more details, please see the following binding document.
    (Documentation/devicetree/bindings/regulator/regulator.txt)

Example:

/include/ "rtp590x.dtsi"
&rtp590x{
	rtp590x: rtp5903@30 {
		compatible = "realtek,rtp5903";
		reg = <0x30>;
		status = "okay";

		regulators {

			ldo3_reg: regulator@2 {
				regulator-name= "LDO1";
				regulator-microvolt = <1800000>;
				regulator-min-microvolt = <1800000>;
				regulator-max-microvolt = <3300000>;
				regulator-state-mem {
					regulator-off-in-suspend;
				};
				regulator-state-disk {
					regulator-off-in-suspend;
				};
			};
...
		};
	};
};
```

## Documentation/devicetree/bindings/reset/realtek,rts-reset.txt
```
RTS3903 Reset Controller
=============================================================================

This binding describes a reset controller device that is used to force reset
individual IP blocks within the RTS3903 SoC using "force reset" control bits
found in the RTS3903 SoC System controller registers.

Please refer to Documentation/devicetree/bindings/reset/reset.txt
for common reset controller binding usage.

Required properties:

- compatible: Contains "realtek,rts3903-reset"

- #reset-cells: Contains 1

Example:

	reset: reset-controller@18860000 {
		compatible = "realtek,rts3903-reset";
		reg = <0x18860000 0x10000>;
		#reset-cells = <1>;
	};

Specifying reset control of devices
=======================================

Device nodes should specify the reset channel required in their "resets"
property, containing a phandle to the RTS3903 reset device node and an
index specifying which reset to use, as described in
Documentation/devicetree/bindings/reset/reset.txt.

Example:

	crypto: crypto@18600000 {
		...
		resets = <&reset FORCE_RESET_CIPHER>;
		reset-names = "rst";
		...
	};

Macro definitions for the supported resets can be found in:
include/dt-bindings/reset/rts-resets.h
```
