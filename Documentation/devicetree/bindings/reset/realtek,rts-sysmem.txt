## Documentation/devicetree/bindings/reset/realtek,rts-sysmem.txt
```
RTS3903 Reset Controller
=============================================================================

This binding describes the memory power control blocks in the RTS3903 SoC
System controller registers.

Please refer to Documentation/devicetree/bindings/reset/reset.txt
for common reset controller binding usage.

Required properties:

- compatible: Contains "realtek,rts3903-sysmem"

- #reset-cells: Contains 1

Example:

	sysmem: reset-controller@18866000 {
		compatible = "realtek,rts3903-sysmem";
		reg = <0x18866000 0x1000>;
		#reset-cells = <1>;
	};

Specifying reset control of devices
=======================================

Device nodes should specify the reset channel required in their "resets"
property, containing a phandle to the RTS3903 sysmem device node and an
index specifying which reset to use, as described in
Documentation/devicetree/bindings/reset/reset.txt.

Example:

	crypto: crypto@18600000 {
		...
		resets = <&sysmem SYS_MEM_SD_CIPHER>;
		reset-names = "sd";
		...
	};

Macro definitions for the supported resets can be found in:
include/dt-bindings/reset/rts-sysmem.h
```

## Documentation/devicetree/bindings/rtc/realtek,rts-rtc.txt
```
Realtek Real Time Clock

Required properties:
- compatible: "realtek,rts3903-rtc"
- reg: Address range of the RTC registers
- interrupt: Should contain the RTC interrupt number
- interrupt-parent: Should be the phandle for the interrupt controller
  that services interrupts for this device

Example:

	rtc: rtc@0x18850000 {
		compatible = "realtek,rts3903-rtc";
		reg = <0x18850000 0x1000>;
		interrupts = <RTC_ALARM0_INT_IRQ>;
		interrupt-parent = <&cpuintc>;
		status = "disabled";
	};
```

## Documentation/devicetree/bindings/serial/realtek,rts-uart.txt
```
* Universal Asynchronous Receiver/Transmitter (UART)

- compatible: "snps,dw-apb-uart"

  Compatibility with all RTS39xx SOCs.

- reg: The base address of the UART register bank.

- interrupts: A single interrupt specifier.

- interrupt-parent: Defines the parent interrupt controller.

- reg-shift : quantity to shift the register offsets by.  If this property is not present then the register offsets are not shifted.

- reg-io-width : the size (in bytes) of the IO accesses that should be performed on the device.  If this property is not present then single byte accesses are used.

- clock-frequency : the input clock frequency for the UART.

- clocks : phandle to the input clock

- clock-names : If provided must be "uart_ck".

Example:

uart0: serial@18810000 {
		compatible = "snps,dw-apb-uart","ns16550a";
		reg = <0x18810000 0x100>;
		interrupts = <BSP_IRQ_OTHERS>;
		interrupt-parent = <&cpuintc>;
		clock-frequency = <24000000>;
		reg-shift = <2>;
		reg-io-width = <4>;
		clocks = <&clks RLX_CLK_UART_CK>;
		clock-names = "uart_ck";
	};
```

## Documentation/devicetree/bindings/sound/realtek,rts-codec.txt
```
Realtek internal audio CODEC

Required properties:
- compatible: "realtek,rts3903-acodec"
- reg: physical base address of the device and length of memory mapped
region
- resets: List of phandle and reset specifier pairs, one pair for
each reset signal that affects the device
- reset-names: List of reset signal name strings sorted in the same order as
the resets property

Example:

	audio_codec: audio_codec@18500070 {
		compatible = "realtek,rts3903-acodec";
		reg = <0x18500070 0x64 0x18500100 0x18>;
		resets = <&reset FORCE_RESET_CODEC>;
		reset-names = "reset-codec";
		status = "disabled";
	};
```

## Documentation/devicetree/bindings/sound/realtek,rts-dma.txt
```
Realtek audio DMA engine

Required properties:
- compatible: "realtek,rts3903-adma"
- reg: physical base address of the audio dma engine and length of memory mapped
region
- memory-region: the audio reserved memory
- interrupt-parent: Phandle of the parent interrupt controller
- interrupts : Should contain the i2s interrupt number
- resets: List of phandle and reset specifier pairs, one pair for
each reset signal that affects the device
- reset-names: List of reset signal name strings sorted in the same order as
the resets property

Example:

	audio_dma: audio_dma@18500000 {
		compatible = "realtek,rts3903-adma";
		reg = <0x18500000 0x64 0x185000E4 0xc>;
		memory-region = <&audio_reserved>;
		interrupt-parent = <&vecintc>;
		interrupts = <BSP_IRQ_I2S>;
		resets = <&sysmem SYS_MEM_SD_AUDIO>;
		reset-names = "audio-sysmem-up";
		status = "disabled";
	};
```

## Documentation/devicetree/bindings/sound/realtek,rts-i2s.txt
```
Realtek I2S controller

Required properties:
- compatible: "realtek,rts3903-adai"
- reg: physical base address of the I2S controller and length of memory mapped
region
- resets: List of phandle and reset specifier pairs, one pair for
each reset signal that affects the device
- reset-names: List of reset signal name strings sorted in the same order as
the resets property

Example:

	audio_i2s: audio_i2s@18500064 {
		compatible = "realtek,rts3903-adai";
		reg = <0x18500064 0xc 0x185000D4 0x4 0x185000E0 0x4>;
		resets = <&reset FORCE_RESET_I2S>,	\
				<&reset FORCE_RESET_SPDIF>;
		reset-names = "reset-i2s", "reset-spdif";
		status = "disabled";
	};
```

## Documentation/devicetree/bindings/spi/realtek,dw-apb-ssi.txt
```
Realtek DesignWare SSI Interface.

Required properties:
- compatible : "realtek,dw-apb-ssi"
- reg : The register base for the controller.
- interrupts : Should contain the SSI interrupt number.
- #address-cells : <1>, as required by generic SPI binding.
- #size-cells : <0>, also as required by generic SPI binding.
- clocks : Clock for ssi controller

Optional properties:
- num-cs : The number of chipselects. If omitted, this will default to 4.
- reg-io-width : The I/O register width (in bytes) implemented by this
  device.  Supported values are 2 or 4 (the default).
- interrupt-parent: Should be the phandle for the interrupt controller

Child nodes as per the generic SPI binding.

Example:

	spi@0x18830000 {
		compatible = "realtek,dw-apb-ssi";
		reg = <0x18830000 0x10000>;
		interrupts = <BSP_IRQ_OTHERS>;
		#address-cells = <1>;
		#size-cells = <0>;
		num-cs = <2>;
	};
```

## Documentation/devicetree/bindings/thermal/realtek,rts-thermal.txt
```
Realtek rts39xx SoC Thermal Sensor Properties

Required properties:
- compatible: "realtek,rts3903-tm"
- reg: Address and length of the register set for the device
- interrupt-parent: Phandle of the parent interrupt controller
- interrupts: Should contain ethernet controller interrupt
- num-trips : number of total trip points, this is required, set it 0 if none,
  if greater than 0, the following properties must be defined
- tripN-temp : temperature of trip point N, should be in ascending order
- thermal_k : temperature mapping curve used to adjusting reading

Example:

thermal: thermal@0x18864000 {
	compatible = "realtek,rts3903-tm";
	reg = <0x18864000 0x100>;
	interrupts = <BSP_IRQ_OTHERS>;
	interrupt-parent = <&cpuintc>;
	num-trips = <2>;
	trip0-temp = <0>;
	trip1-temp = <80000>;
	thermal_k = /bits/ 32 <14333 18538 23329
				28806 33907 39053 44489 49630
				54314 59211 64267 69322 74799
				79665 84613 89826 94970 100121>;
};
```

## Documentation/devicetree/bindings/timer/realtek,rts-timer.txt
```
* Realtek Timer

Required properties:
- compatible: "realtek,rts3913-timer"
- reg: Address range of the timer registers
- interrupt: Should contain the timer interrupt number

Example:

	timer: timer@18890000 {
		compatible = "realtek,rts3913-timer";
		reg = <0x18890000 0x100>;
		interrupt-parent = <&vecintc>;
		interrupts = <BSP_IRQ_TIMER>;
	};
```

## Documentation/devicetree/bindings/usb/realtek,rts-ehci.txt
```
Realtek rts39xx SoC USB EHCI controllers

Required properties:
  - compatible : should be "realtek,rts3903-ehci".
  - reg : should contain at least address and length of the standard EHCI
    register set for the device. Optional platform-dependent registers
    (debug-port or other) can be also specified here, but only after
    definition of standard EHCI registers.
  - interrupt-parent: Phandle of the parent interrupt controller
  - interrupts : one EHCI interrupt should be described here.
  - resets: List of phandle and reset specifier pairs, one pair for
  each reset signal that affects the device
  - reset-names: List of reset signal name strings sorted in the same order as
  the resets property

Example:
	usb_ehci: ehci@18100000 {
			compatible = "realtek,rts3903-ehci";
			reg = <0x18100000 0x1000>;
			interrupt-parent = <&vecintc>;
			interrupts = <BSP_IRQ_USBHOST>;
			resets = <&reset FORCE_RESET_U2HOST>;
			reset-names = "reset-usb-host";
	};
```

## Documentation/devicetree/bindings/usb/realtek,rts-ohci.txt
```
Realtek rts39xx SoC USB OHCI controllers

Required properties:
- compatible : "realtek,rts3903-ohci"
- reg : ohci controller register range (address and length)
- interrupt-parent: Phandle of the parent interrupt controller
- interrupts : ohci controller interrupt
- resets: List of phandle and reset specifier pairs, one pair for
each reset signal that affects the device
- reset-names: List of reset signal name strings sorted in the same order as
the resets property

Example:

	usb_ohci: ohci@18180000 {
			compatible = "realtek,rts3903-ohci";
			reg = <0x18180000 0x1000>;
			interrupt-parent = <&vecintc>;
			interrupts = <BSP_IRQ_USBHOST>;
			resets = <&reset FORCE_RESET_U2HOST>;
			reset-names = "reset-usb-host";
	};
```

## Documentation/devicetree/bindings/usb/realtek,rts-otg.txt
```
Realtek rts39xx SoC USB Device Properties

Required properties:
- compatible: "realtek,rts3903-otg"
- reg: Address and length of the register set for the device
- interrupt-parent: Phandle of the parent interrupt controller
- interrupts: Should contain ethernet controller interrupt
- resets: List of phandle and reset specifier pairs, one pair for
each reset signal that affects the device
- reset-names: List of reset signal name strings sorted in the same order as
the resets property

Example:

usb_device: dwc_otg@18200000 {
			compatible = "realtek,rts3903-otg";
			reg = <0x18200000 0x40000>;
			interrupt-parent = <&cpuintc>;
			interrupts = <BSP_IRQ_USBDEV>;
			resets = <&reset FORCE_RESET_U2DEV>,	\
			<&sysmem SYS_MEM_SD_U2DEV>;
			reset-names = "reset-usb-device", "u2dev-sysmem-up";
};
```

## Documentation/devicetree/bindings/watchdog/realtek,rts-wdt.txt
```
Realtek Watchdog Timer Controller

Required properties:
- compatible: "realtek,rts3903-wd"
- reg: Address range of the WDT registers

Example:

	watchdog: watchdog@0x18862000 {
		compatible = "realtek,rts3903-wd";
		reg = <0x18862000 0x10000>;
		status = "disabled";
	};
```

## arch/mips/configs/realtek_rts3903_defconfig
```kconfig
CONFIG_INITRAMFS_SOURCE=""
CONFIG_INITRAMFS_ROOT_UID=1000
CONFIG_INITRAMFS_ROOT_GID=1000
CONFIG_SOC_ENABLE_USB=y
CONFIG_DTB_RTS3903_EVB=y
# CONFIG_COMPACTION is not set
# CONFIG_SECCOMP is not set
CONFIG_MIPS_RAW_APPENDED_DTB=y
CONFIG_CROSS_COMPILE="mips-linux-"
# CONFIG_LOCALVERSION_AUTO is not set
CONFIG_KERNEL_LZMA=y
CONFIG_DEFAULT_HOSTNAME=""
CONFIG_SYSVIPC=y
CONFIG_POSIX_MQUEUE=y
CONFIG_NO_HZ_IDLE=y
CONFIG_LOG_BUF_SHIFT=12
CONFIG_CC_OPTIMIZE_FOR_SIZE=y
CONFIG_SYSCTL_SYSCALL=y
# CONFIG_KALLSYMS is not set
CONFIG_BASE_FULL=y
CONFIG_SHMEM=y
CONFIG_EMBEDDED=y
# CONFIG_VM_EVENT_COUNTERS is not set
CONFIG_MODULES=y
CONFIG_MODULE_FORCE_LOAD=y
CONFIG_MODULE_UNLOAD=y
CONFIG_MODULE_FORCE_UNLOAD=y
# CONFIG_COREDUMP is not set
# CONFIG_SUSPEND is not set
CONFIG_CPU_FREQ=y
CONFIG_CPU_FREQ_GOV_POWERSAVE=y
CONFIG_CPU_FREQ_GOV_USERSPACE=y
CONFIG_CPUFREQ_DT=y
CONFIG_RTS_CPUFREQ=y
CONFIG_NET=y
CONFIG_PACKET=y
CONFIG_UNIX=y
CONFIG_INET=y
CONFIG_IP_MULTICAST=y
CONFIG_IP_MROUTE=y
# CONFIG_INET_XFRM_MODE_TRANSPORT is not set
# CONFIG_INET_XFRM_MODE_TUNNEL is not set
# CONFIG_INET_XFRM_MODE_BEET is not set
# CONFIG_INET_DIAG is not set
# CONFIG_IPV6 is not set
CONFIG_NETFILTER=y
CONFIG_BRIDGE_NETFILTER=y
CONFIG_NF_CONNTRACK=y
# CONFIG_NF_CONNTRACK_PROCFS is not set
CONFIG_NETFILTER_XT_TARGET_DSCP=y
CONFIG_NETFILTER_XT_TARGET_TCPMSS=y
CONFIG_NETFILTER_XT_MATCH_DSCP=y
CONFIG_NETFILTER_XT_MATCH_IPRANGE=y
CONFIG_NF_CONNTRACK_IPV4=y
CONFIG_IP_NF_IPTABLES=y
CONFIG_IP_NF_FILTER=y
CONFIG_IP_NF_NAT=y
CONFIG_IP_NF_TARGET_MASQUERADE=y
CONFIG_IP_NF_MANGLE=y
CONFIG_BRIDGE=y
# CONFIG_BRIDGE_IGMP_SNOOPING is not set
CONFIG_NETLINK_DIAG=y
CONFIG_NET_PKTGEN=y
CONFIG_HAMRADIO=y
CONFIG_CAN=y
CONFIG_IRDA=y
CONFIG_BT=y
CONFIG_CFG80211=y
CONFIG_CFG80211_WEXT=y
CONFIG_MAC80211=y
CONFIG_MAC80211_RC_MINSTREL_VHT=y
CONFIG_MAC80211_MESH=y
CONFIG_RFKILL=y
CONFIG_DEVTMPFS=y
CONFIG_DEVTMPFS_MOUNT=y
CONFIG_MTD=y
CONFIG_MTD_CMDLINE_PARTS=y
CONFIG_MTD_BLOCK=y
CONFIG_MTD_CFI=y
CONFIG_MTD_CFI_ADV_OPTIONS=y
CONFIG_RTS_HCONF=y
CONFIG_MTD_SPI_NOR=y
CONFIG_SPI_RTS_QUADSPI=y
CONFIG_DBG_IOMEM=y
CONFIG_WLAN_WPS=y
CONFIG_NETDEVICES=y
# CONFIG_NET_VENDOR_AMAZON is not set
# CONFIG_NET_VENDOR_ARC is not set
# CONFIG_NET_CADENCE is not set
# CONFIG_NET_VENDOR_BROADCOM is not set
# CONFIG_NET_VENDOR_EZCHIP is not set
# CONFIG_NET_VENDOR_INTEL is not set
# CONFIG_NET_VENDOR_MARVELL is not set
# CONFIG_NET_VENDOR_MICREL is not set
# CONFIG_NET_VENDOR_NATSEMI is not set
# CONFIG_NET_VENDOR_NETRONOME is not set
# CONFIG_NET_VENDOR_QUALCOMM is not set
CONFIG_RTL8168G=y
# CONFIG_NET_VENDOR_RENESAS is not set
# CONFIG_NET_VENDOR_ROCKER is not set
# CONFIG_NET_VENDOR_SAMSUNG is not set
# CONFIG_NET_VENDOR_SEEQ is not set
# CONFIG_NET_VENDOR_SMSC is not set
# CONFIG_NET_VENDOR_STMICRO is not set
# CONFIG_NET_VENDOR_SYNOPSYS is not set
# CONFIG_NET_VENDOR_VIA is not set
# CONFIG_NET_VENDOR_WIZNET is not set
# CONFIG_NET_VENDOR_XILINX is not set
CONFIG_PPP=y
CONFIG_PPP_MPPE=y
CONFIG_PPPOE=y
CONFIG_PPP_ASYNC=y
CONFIG_PPP_SYNC_TTY=y
# CONFIG_INPUT is not set
# CONFIG_SERIO is not set
# CONFIG_VT is not set
# CONFIG_DEVKMEM is not set
CONFIG_SERIAL_8250=y
CONFIG_SERIAL_8250_CONSOLE=y
CONFIG_SERIAL_8250_NR_UARTS=3
CONFIG_SERIAL_8250_RUNTIME_UARTS=3
# CONFIG_HW_RANDOM is not set
CONFIG_I2C_CHARDEV=y
CONFIG_I2C_DESIGNWARE_PLATFORM=y
CONFIG_SPI=y
CONFIG_PINCTRL_RTS=y
CONFIG_GPIO_SYSFS=y
CONFIG_GPIO_RTP=y
# CONFIG_HWMON is not set
CONFIG_THERMAL=y
CONFIG_RTS_THERMAL=y
CONFIG_WATCHDOG=y
CONFIG_RTSX_WATCHDOG=y
CONFIG_MFD_RTP=y
CONFIG_REGULATOR=y
CONFIG_REGULATOR_RTP=y
CONFIG_SOUND=y
CONFIG_SND=y
CONFIG_SND_SOC=y
CONFIG_USB_ARCH_HAS_OHCI=y
CONFIG_USB_ARCH_HAS_EHCI=y
CONFIG_USB=y
CONFIG_USB_ANNOUNCE_NEW_DEVICES=y
CONFIG_USB_EHCI_HCD=y
CONFIG_USB_EHCI_RTS=y
CONFIG_USB_OHCI_HCD=y
CONFIG_USB_OHCI_RTS=y
CONFIG_DWC_OTG=y
CONFIG_DWC_OTG_DEVICE_ONLY=y
CONFIG_USB_RTS_PHY=y
CONFIG_USB_GADGET=y
CONFIG_MMC=y
CONFIG_RTC_CLASS=y
CONFIG_RTC_DRV_RTS=y
CONFIG_DMADEVICES=y
CONFIG_RTS_DMAC=y
CONFIG_RTS_CLK=y
# CONFIG_IOMMU_SUPPORT is not set
CONFIG_NVMEM=y
CONFIG_OVERLAY_FS=y
CONFIG_MSDOS_FS=y
CONFIG_VFAT_FS=y
CONFIG_TMPFS=y
CONFIG_TMPFS_POSIX_ACL=y
CONFIG_CONFIGFS_FS=y
CONFIG_JFFS2_FS=y
CONFIG_JFFS2_FS_XATTR=y
CONFIG_SQUASHFS=y
# CONFIG_SQUASHFS_ZLIB is not set
CONFIG_SQUASHFS_XZ=y
CONFIG_NFS_FS=y
CONFIG_NFS_V4=y
CONFIG_NLS_CODEPAGE_437=y
CONFIG_NLS_CODEPAGE_936=y
CONFIG_NLS_CODEPAGE_950=y
CONFIG_NLS_ISO8859_1=y
CONFIG_PRINTK_TIME=y
# CONFIG_SCHED_DEBUG is not set
# CONFIG_FTRACE is not set
CONFIG_CRYPTO_ECHAINIV=y
CONFIG_CRYPTO_DEV_REALTEK=y
CONFIG_MEDIA_SUPPORT=y
CONFIG_REALTEK_IPCAMERA=y
```
